## conf/machine/include/torizon-secondaries.inc
```bitbake
# Preserve registered ECUs across updates: Cloud rejects an ECU that disappears and returns.
# Helpers let a plain assignment to the public variable in local.conf take precedence.

# Toradex machines
TORIZON_SECONDARY_BOOTLOADER_DEFAULT:apalis-imx6 = "1"
TORIZON_SECONDARY_FUSES_DEFAULT:apalis-imx6 = "1"
BOOTLOADER_ACTION_HANDLER_TYPE_DEFAULT:apalis-imx6 = "uboot-emmc"
TORIZON_SECONDARY_BOOTLOADER_DEFAULT:apalis-imx8 = "1"
TORIZON_SECONDARY_FUSES_DEFAULT:apalis-imx8 = "1"
BOOTLOADER_ACTION_HANDLER_TYPE_DEFAULT:apalis-imx8 = "uboot-emmc"
TORIZON_SECONDARY_BOOTLOADER_DEFAULT:aquila-am69 = "1"
TORIZON_SECONDARY_BOOTLOADER_DEFAULT:aquila-imx95 = "1"
TORIZON_SECONDARY_FUSES_DEFAULT:aquila-imx95 = "1"
TORIZON_SECONDARY_BOOTLOADER_DEFAULT:colibri-imx6 = "1"
TORIZON_SECONDARY_FUSES_DEFAULT:colibri-imx6 = "1"
BOOTLOADER_ACTION_HANDLER_TYPE_DEFAULT:colibri-imx6 = "uboot-emmc"
TORIZON_SECONDARY_BOOTLOADER_DEFAULT:colibri-imx6ull-emmc = "1"
TORIZON_SECONDARY_FUSES_DEFAULT:colibri-imx6ull-emmc = "1"
BOOTLOADER_ACTION_HANDLER_TYPE_DEFAULT:colibri-imx6ull-emmc = "uboot-emmc"
TORIZON_SECONDARY_BOOTLOADER_DEFAULT:colibri-imx7-emmc = "1"
TORIZON_SECONDARY_FUSES_DEFAULT:colibri-imx7-emmc = "1"
BOOTLOADER_ACTION_HANDLER_TYPE_DEFAULT:colibri-imx7-emmc = "uboot-emmc"
TORIZON_SECONDARY_BOOTLOADER_DEFAULT:colibri-imx8x = "1"
TORIZON_SECONDARY_FUSES_DEFAULT:colibri-imx8x = "1"
BOOTLOADER_ACTION_HANDLER_TYPE_DEFAULT:colibri-imx8x = "uboot-emmc"
TORIZON_SECONDARY_BOOTLOADER_DEFAULT:genericx86-64 = "1"
TORIZON_SECONDARY_BOOTLOADER_DEFAULT:lino-imx93 = "1"
TORIZON_SECONDARY_FUSES_DEFAULT:lino-imx93 = "1"
TORIZON_SECONDARY_BOOTLOADER_DEFAULT:qemuarm64 = "1"
TORIZON_SECONDARY_BOOTLOADER_DEFAULT:toradex-osm-imx93 = "1"
TORIZON_SECONDARY_FUSES_DEFAULT:toradex-osm-imx93 = "1"
TORIZON_SECONDARY_BOOTLOADER_DEFAULT:toradex-smarc-imx8mp = "1"
TORIZON_SECONDARY_FUSES_DEFAULT:toradex-smarc-imx8mp = "1"
TORIZON_SECONDARY_BOOTLOADER_DEFAULT:toradex-smarc-imx95 = "1"
TORIZON_SECONDARY_FUSES_DEFAULT:toradex-smarc-imx95 = "1"
TORIZON_SECONDARY_BOOTLOADER_DEFAULT:verdin-am62 = "1"
BOOTLOADER_ACTION_HANDLER_TYPE_DEFAULT:verdin-am62 = "uboot-emmc"
TORIZON_SECONDARY_BOOTLOADER_DEFAULT:verdin-am62p = "1"
BOOTLOADER_ACTION_HANDLER_TYPE_DEFAULT:verdin-am62p = "uboot-emmc"
TORIZON_SECONDARY_BOOTLOADER_DEFAULT:verdin-imx8mm = "1"
TORIZON_SECONDARY_FUSES_DEFAULT:verdin-imx8mm = "1"
BOOTLOADER_ACTION_HANDLER_TYPE_DEFAULT:verdin-imx8mm = "uboot-emmc"
TORIZON_SECONDARY_BOOTLOADER_DEFAULT:verdin-imx8mp = "1"
TORIZON_SECONDARY_FUSES_DEFAULT:verdin-imx8mp = "1"
BOOTLOADER_ACTION_HANDLER_TYPE_DEFAULT:verdin-imx8mp = "uboot-emmc"
TORIZON_SECONDARY_BOOTLOADER_DEFAULT:verdin-imx95 = "1"
TORIZON_SECONDARY_FUSES_DEFAULT:verdin-imx95 = "1"

# TI machines
TORIZON_SECONDARY_BOOTLOADER_DEFAULT:am62lxx-evm = "1"
TORIZON_SECONDARY_BOOTLOADER_DEFAULT:am62pxx-evm = "1"
TORIZON_SECONDARY_BOOTLOADER_DEFAULT:am62xx-evm = "1"
TORIZON_SECONDARY_BOOTLOADER_DEFAULT:beagley-ai = "1"

# NXP machines
TORIZON_SECONDARY_BOOTLOADER_DEFAULT:imx93frdm = "1"
TORIZON_SECONDARY_FUSES_DEFAULT:imx93frdm = "1"
TORIZON_SECONDARY_BOOTLOADER_DEFAULT:imx6sxsabresd = "1"
TORIZON_SECONDARY_FUSES_DEFAULT:imx6sxsabresd = "1"
TORIZON_SECONDARY_BOOTLOADER_DEFAULT:imx95-19x19-verdin = "1"
TORIZON_SECONDARY_FUSES_DEFAULT:imx95-19x19-verdin = "1"

# Intel machines
TORIZON_SECONDARY_BOOTLOADER_DEFAULT:intel-corei7-64 = "1"

# NVIDIA machines
TORIZON_SECONDARY_BOOTLOADER_DEFAULT:jetson-orin-nano-devkit = "1"
TORIZON_SECONDARY_BOOTLOADER_DEFAULT:jetson-orin-nano-devkit-nvme = "1"
TORIZON_SECONDARY_BOOTLOADER_DEFAULT:jetson-agx-thor-devkit = "1"
TORIZON_SECONDARY_BOOTLOADER_DEFAULT:jetson-agx-thor-t4000 = "1"

# MediaTek machines
TORIZON_SECONDARY_BOOTLOADER_DEFAULT:lec-mtk-i1200-ufs = "1"

# Qualcomm machines
TORIZON_SECONDARY_BOOTLOADER_DEFAULT:ventuno-q = "0"

# Synaptics machines
TORIZON_SECONDARY_BOOTLOADER_DEFAULT:sl1680 = "1"
TORIZON_SECONDARY_BOOTLOADER_DEFAULT:sl2619 = "1"
TORIZON_SECONDARY_BOOTLOADER_DEFAULT:luna-sl1680 = "1"

# Renesas machines
TORIZON_SECONDARY_BOOTLOADER_DEFAULT:smarc-rzv2l = "1"

# STMicroelectronics machines
TORIZON_SECONDARY_BOOTLOADER_DEFAULT:stm32mp15-disco = "1"
TORIZON_SECONDARY_BOOTLOADER_DEFAULT:stm32mp25-disco = "1"
TORIZON_SECONDARY_BOOTLOADER_DEFAULT:stm32mp25-eval = "1"
```
